/ {
    led_control_devs {
        compatible = "org,led_control";
        
        gpio1 {
            label = "P9_PIN25_gpio3.21";
            bone-gpios = <&gpio3 21 GPIO_ACTIVE_HIGH>;
        };

        gpio2 {
            label = "P9_PIN27_gpio3.19";
            bone-gpios = <&gpio3 19 GPIO_ACTIVE_HIGH>;
        };
    };
};
